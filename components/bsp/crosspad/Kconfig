## components/bsp/crosspad/Kconfig
```kconfig
menu "Board Support Package(CrossPad)"

    config BSP_ERROR_CHECK
        bool "Enable error check in BSP"
        default y
        help
            Error check assert the application before returning the error code.

    choice BSP_BOARD_REV
        prompt "CrossPad PCB revision"
        default BSP_BOARD_REV_V1
        help
            Selects which PCB revision the firmware targets. Each revision
            has its own pinout header under include/pinout/. Capabilities
            (e.g. dedicated STM32 I2C bus) may differ between revisions.

        config BSP_BOARD_REV_V1
            bool "Rev 1.x (STM32 over UART, single sensor I2C bus)"

        config BSP_BOARD_REV_V2
            bool "Rev 2.0 (UART for MIDI + dedicated STM32 I2C, ESP master)"
    endchoice

    config BSP_BOARD_REV_STR
        string
        default "v1" if BSP_BOARD_REV_V1
        default "v2" if BSP_BOARD_REV_V2

    menu "I2C"
        config BSP_I2C_NUM
            int "I2C peripheral index"
            default 1
            range 0 1
            help
                ESP32S3 has two I2C peripherals, pick the one you want to use.

        config BSP_I2C_FAST_MODE
            bool "Enable I2C fast mode"
            default y
            help
                I2C has two speed modes: normal (100kHz) and fast (400kHz).

        config BSP_I2C_CLK_SPEED_HZ
            int
            default 400000 if BSP_I2C_FAST_MODE
            default 100000
    endmenu

    menu "SD card - Virtual File System"
        config BSP_SD_FORMAT_ON_MOUNT_FAIL
            bool "Format SD card if mounting fails"
            default n
            help
                The SDMMC host will format (FAT) the SD card if it fails to mount the filesystem.

        config BSP_SD_MOUNT_POINT
            string "SD card mount point"
            default "/sdcard"
            help
                Mount point of the SD card in the Virtual File System

    endmenu

    menu "Display"

        config BSP_LCD_DRAW_BUF_HEIGHT
        int "LCD framebuf height"
        default 100
        range 10 240
        help
            Framebuf is used for lvgl rendering output.

        config BSP_LCD_DRAW_BUF_DOUBLE
        bool "LCD double framebuf"
        default n
        help
            Whether to enable double framebuf.
    endmenu
    
    config BSP_I2S_NUM
        int "I2S peripheral index"
        default 1
        range 0 1
        help
            ESP32S3 has two I2S peripherals, pick the one you want to use.
endmenu
```

## components/crosspad-platform-idf/Kconfig
```kconfig
menu "CrossPad sampler engines"

    config CROSSPAD_SAMPLER_MARCEL
        bool "Build the prebuilt sample streamer beside the native engine"
        default n
        help
            The native engine (crosspad-core src/sampler, SamplerEnginePort.cpp)
            plays every sampler kit. This option builds the prebuilt streamer
            (components/ml_sample_stream_player_lib, main/sample_player_port.cpp's
            library glue, engine_handoff's start/stop, MarcelSampleNode) back in,
            with its own "Sampler" mixer channel and the native engine on
            "Sampler2", so the two can be A/B'd with SMPL_ENGINE native|marcel.

            Off (the default) the image is ~25 kB of code smaller, the arena
            belongs to the native engine from boot, the native engine's mixer
            channel is "Sampler" in the slot the prebuilt one used to have, and
            SMPL_ENGINE answers that only the native engine exists.

endmenu
```
